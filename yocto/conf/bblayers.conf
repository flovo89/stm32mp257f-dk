## yocto/conf/bblayers.conf
```bitbake
# =============================================================================
# STM32MP257F-DK — bblayers.conf
# ${TOPDIR} = yocto/build/
# =============================================================================

BBPATH  = "${TOPDIR}"
BBFILES ?= ""

BBLAYERS ?= " \
    ${TOPDIR}/../../layers/poky/meta                             \
    ${TOPDIR}/../../layers/poky/meta-poky                        \
    ${TOPDIR}/../../layers/meta-openembedded/meta-oe             \
    ${TOPDIR}/../../layers/meta-openembedded/meta-python         \
    ${TOPDIR}/../../layers/meta-openembedded/meta-networking     \
    ${TOPDIR}/../../layers/meta-openembedded/meta-filesystems    \
    ${TOPDIR}/../../layers/meta-openembedded/meta-webserver      \
    ${TOPDIR}/../../layers/meta-arm/meta-arm                     \
    ${TOPDIR}/../../layers/meta-arm/meta-arm-toolchain           \
    ${TOPDIR}/../../layers/meta-st-stm32mp                       \
    ${TOPDIR}/../../layers/meta-st-openstlinux                   \
    ${TOPDIR}/../../layers/meta-swupdate                         \
    ${TOPDIR}/../../layers/meta-custom                           \
    "
```

## yocto/layers/meta-custom/conf/layer.conf
```bitbake
BBPATH .= ":${LAYERDIR}"

BBFILES += " \
    ${LAYERDIR}/recipes-*/*/*.bb      \
    ${LAYERDIR}/recipes-*/*/*.bbappend \
"

BBFILE_COLLECTIONS += "meta-custom"
BBFILE_PATTERN_meta-custom  = "^${LAYERDIR}/"
BBFILE_PRIORITY_meta-custom = "10"

LAYERSERIES_COMPAT_meta-custom = "scarthgap"

# Let wic discover .wks files from this layer
WKS_SEARCH_PATH:prepend = "${LAYERDIR}/wic:"
```

## zephyr/build/Kconfig/arch/Kconfig.tmp
```kconfig
# Load Zephyr Arch Kconfig descriptions.
osource "/home/flo/projects/stm32mp257f-dk/zephyr/zephyr/arch/rx/Kconfig"
osource "/home/flo/projects/stm32mp257f-dk/zephyr/zephyr/arch/x86/Kconfig"
osource "/home/flo/projects/stm32mp257f-dk/zephyr/zephyr/arch/xtensa/Kconfig"
osource "/home/flo/projects/stm32mp257f-dk/zephyr/zephyr/arch/sparc/Kconfig"
osource "/home/flo/projects/stm32mp257f-dk/zephyr/zephyr/arch/riscv/Kconfig"
osource "/home/flo/projects/stm32mp257f-dk/zephyr/zephyr/arch/posix/Kconfig"
osource "/home/flo/projects/stm32mp257f-dk/zephyr/zephyr/arch/openrisc/Kconfig"
osource "/home/flo/projects/stm32mp257f-dk/zephyr/zephyr/arch/mips/Kconfig"
osource "/home/flo/projects/stm32mp257f-dk/zephyr/zephyr/arch/arm64/Kconfig"
osource "/home/flo/projects/stm32mp257f-dk/zephyr/zephyr/arch/arm/Kconfig"
osource "/home/flo/projects/stm32mp257f-dk/zephyr/zephyr/arch/arc/Kconfig"
```

## zephyr/build/Kconfig/boards/Kconfig.defconfig
```kconfig
# Load Zephyr board defconfig descriptions.
osource "/home/flo/projects/stm32mp257f-dk/zephyr/zephyr/boards/st/stm32mp257f_dk/Kconfig.defconfig"
```

## zephyr/build/Kconfig/boards/Kconfig.stm32mp257f_dk.tmp
```kconfig
# Load board Kconfig descriptions.
osource "/home/flo/projects/stm32mp257f-dk/zephyr/zephyr/boards/st/stm32mp257f_dk/Kconfig.stm32mp257f_dk"
```

## zephyr/build/Kconfig/boards/Kconfig.sysbuild
```kconfig
# Load Sysbuild board Kconfig descriptions.
osource "/home/flo/projects/stm32mp257f-dk/zephyr/zephyr/boards/st/stm32mp257f_dk/Kconfig.sysbuild"
```

## zephyr/build/Kconfig/boards/Kconfig.tmp
```kconfig
# Load Zephyr board Kconfig descriptions.
osource "/home/flo/projects/stm32mp257f-dk/zephyr/zephyr/boards/st/stm32mp257f_dk/Kconfig"
```

## zephyr/build/Kconfig/soc/Kconfig.tmp
```kconfig
# Load Zephyr SoC Kconfig descriptions.
osource "/home/flo/projects/stm32mp257f-dk/zephyr/zephyr/soc/xlnx/zynqmp/Kconfig"
osource "/home/flo/projects/stm32mp257f-dk/zephyr/zephyr/soc/xlnx/zynq7000/Kconfig"
osource "/home/flo/projects/stm32mp257f-dk/zephyr/zephyr/soc/xlnx/versalnet/Kconfig"
osource "/home/flo/projects/stm32mp257f-dk/zephyr/zephyr/soc/xlnx/versal2/Kconfig"
osource "/home/flo/projects/stm32mp257f-dk/zephyr/zephyr/soc/xlnx/versal/Kconfig"
osource "/home/flo/projects/stm32mp257f-dk/zephyr/zephyr/soc/xen/Kconfig"
osource "/home/flo/projects/stm32mp257f-dk/zephyr/zephyr/soc/wch/ch32v/Kconfig"
osource "/home/flo/projects/stm32mp257f-dk/zephyr/zephyr/soc/ti/simplelink/Kconfig"
osource "/home/flo/projects/stm32mp257f-dk/zephyr/zephyr/soc/ti/mspm0/Kconfig"
osource "/home/flo/projects/stm32mp257f-dk/zephyr/zephyr/soc/ti/lm3s6965/Kconfig"
osource "/home/flo/projects/stm32mp257f-dk/zephyr/zephyr/soc/ti/k3/Kconfig"
osource "/home/flo/projects/stm32mp257f-dk/zephyr/zephyr/soc/telink/tlsr/Kconfig"
osource "/home/flo/projects/stm32mp257f-dk/zephyr/zephyr/soc/syna/sr100/Kconfig"
osource "/home/flo/projects/stm32mp257f-dk/zephyr/zephyr/soc/starfive/jh71xx/Kconfig"
osource "/home/flo/projects/stm32mp257f-dk/zephyr/zephyr/soc/st/stm32/Kconfig"
osource "/home/flo/projects/stm32mp257f-dk/zephyr/zephyr/soc/snps/qemu_arc/Kconfig"
osource "/home/flo/projects/stm32mp257f-dk/zephyr/zephyr/soc/snps/nsim/arc_v/Kconfig"
osource "/home/flo/projects/stm32mp257f-dk/zephyr/zephyr/soc/snps/nsim/arc_classic/Kconfig"
osource "/home/flo/projects/stm32mp257f-dk/zephyr/zephyr/soc/snps/hsdk4xd/Kconfig"
osource "/home/flo/projects/stm32mp257f-dk/zephyr/zephyr/soc/snps/hsdk/Kconfig"
osource "/home/flo/projects/stm32mp257f-dk/zephyr/zephyr/soc/snps/emsk/Kconfig"
osource "/home/flo/projects/stm32mp257f-dk/zephyr/zephyr/soc/snps/emsdp/Kconfig"
osource "/home/flo/projects/stm32mp257f-dk/zephyr/zephyr/soc/snps/arc_iot/Kconfig"
osource "/home/flo/projects/stm32mp257f-dk/zephyr/zephyr/soc/silabs/Kconfig"
osource "/home/flo/projects/stm32mp257f-dk/zephyr/zephyr/soc/sifli/sf32/Kconfig"
osource "/home/flo/projects/stm32mp257f-dk/zephyr/zephyr/soc/sifive/sifive_freedom/Kconfig"
osource "/home/flo/projects/stm32mp257f-dk/zephyr/zephyr/soc/sensry/Kconfig"
osource "/home/flo/projects/stm32mp257f-dk/zephyr/zephyr/soc/rockchip/Kconfig"
osource "/home/flo/projects/stm32mp257f-dk/zephyr/zephyr/soc/renode/riscv_virtual/Kconfig"
osource "/home/flo/projects/stm32mp257f-dk/zephyr/zephyr/soc/renode/cortex_r8_virtual/Kconfig"
osource "/home/flo/projects/stm32mp257f-dk/zephyr/zephyr/soc/renesas/smartbond/Kconfig"
osource "/home/flo/projects/stm32mp257f-dk/zephyr/zephyr/soc/renesas/rz/Kconfig"
osource "/home/flo/projects/stm32mp257f-dk/zephyr/zephyr/soc/renesas/rx/Kconfig"
osource "/home/flo/projects/stm32mp257f-dk/zephyr/zephyr/soc/renesas/rcar/Kconfig"
osource "/home/flo/projects/stm32mp257f-dk/zephyr/zephyr/soc/renesas/ra/Kconfig"
osource "/home/flo/projects/stm32mp257f-dk/zephyr/zephyr/soc/realtek/fingerprint/Kconfig"
osource "/home/flo/projects/stm32mp257f-dk/zephyr/zephyr/soc/realtek/ec/Kconfig"
osource "/home/flo/projects/stm32mp257f-dk/zephyr/zephyr/soc/realtek/bee/Kconfig"
osource "/home/flo/projects/stm32mp257f-dk/zephyr/zephyr/soc/realtek/ameba/Kconfig"
osource "/home/flo/projects/stm32mp257f-dk/zephyr/zephyr/soc/raspberrypi/rpi_pico/Kconfig"
osource "/home/flo/projects/stm32mp257f-dk/zephyr/zephyr/soc/quicklogic/eos_s3/Kconfig"
osource "/home/flo/projects/stm32mp257f-dk/zephyr/zephyr/soc/qemu/virt_riscv/Kconfig"
osource "/home/flo/projects/stm32mp257f-dk/zephyr/zephyr/soc/qemu/or1k/Kconfig"
osource "/home/flo/projects/stm32mp257f-dk/zephyr/zephyr/soc/qemu/malta/Kconfig"
osource "/home/flo/projects/stm32mp257f-dk/zephyr/zephyr/soc/openisa/rv32m1/Kconfig"
osource "/home/flo/projects/stm32mp257f-dk/zephyr/zephyr/soc/openhwgroup/cva6/Kconfig"
osource "/home/flo/projects/stm32mp257f-dk/zephyr/zephyr/soc/oct/osd32mp15x/Kconfig"
osource "/home/flo/projects/stm32mp257f-dk/zephyr/zephyr/soc/nxp/s32/Kconfig"
osource "/home/flo/projects/stm32mp257f-dk/zephyr/zephyr/soc/nxp/rw/Kconfig"
osource "/home/flo/projects/stm32mp257f-dk/zephyr/zephyr/soc/nxp/mcx/Kconfig"
osource "/home/flo/projects/stm32mp257f-dk/zephyr/zephyr/soc/nxp/lpc/Kconfig"
osource "/home/flo/projects/stm32mp257f-dk/zephyr/zephyr/soc/nxp/layerscape/Kconfig"
osource "/home/flo/projects/stm32mp257f-dk/zephyr/zephyr/soc/nxp/kinetis/Kconfig"
osource "/home/flo/projects/stm32mp257f-dk/zephyr/zephyr/soc/nxp/imxrt/Kconfig"
osource "/home/flo/projects/stm32mp257f-dk/zephyr/zephyr/soc/nxp/imx/Kconfig"
osource "/home/flo/projects/stm32mp257f-dk/zephyr/zephyr/soc/nuvoton/numicro/Kconfig"
osource "/home/flo/projects/stm32mp257f-dk/zephyr/zephyr/soc/nuvoton/numaker/Kconfig"
osource "/home/flo/projects/stm32mp257f-dk/zephyr/zephyr/soc/nuvoton/npcx/Kconfig"
osource "/home/flo/projects/stm32mp257f-dk/zephyr/zephyr/soc/nuvoton/npcm/Kconfig"
osource "/home/flo/projects/stm32mp257f-dk/zephyr/zephyr/soc/nordic/Kconfig"
osource "/home/flo/projects/stm32mp257f-dk/zephyr/zephyr/soc/neorv32/Kconfig"
osource "/home/flo/projects/stm32mp257f-dk/zephyr/zephyr/soc/native/inf_clock/Kconfig"
osource "/home/flo/projects/stm32mp257f-dk/zephyr/zephyr/soc/microchip/sam/sama7/Kconfig"
osource "/home/flo/projects/stm32mp257f-dk/zephyr/zephyr/soc/microchip/sam/sam_d5x_e5x/Kconfig"
osource "/home/flo/projects/stm32mp257f-dk/zephyr/zephyr/soc/microchip/pic64/Kconfig"
osource "/home/flo/projects/stm32mp257f-dk/zephyr/zephyr/soc/microchip/pic32c/pic32cz_ca/Kconfig"
osource "/home/flo/projects/stm32mp257f-dk/zephyr/zephyr/soc/microchip/pic32c/pic32cx_sg/Kconfig"
osource "/home/flo/projects/stm32mp257f-dk/zephyr/zephyr/soc/microchip/pic32c/pic32cm_pl/Kconfig"
osource "/home/flo/projects/stm32mp257f-dk/zephyr/zephyr/soc/microchip/pic32c/pic32cm_jh/Kconfig"
osource "/home/flo/projects/stm32mp257f-dk/zephyr/zephyr/soc/microchip/miv/Kconfig"
osource "/home/flo/projects/stm32mp257f-dk/zephyr/zephyr/soc/microchip/mec/Kconfig"
osource "/home/flo/projects/stm32mp257f-dk/zephyr/zephyr/soc/mediatek/mt8xxx/Kconfig"
osource "/home/flo/projects/stm32mp257f-dk/zephyr/zephyr/soc/lowrisc/opentitan/Kconfig"
osource "/home/flo/projects/stm32mp257f-dk/zephyr/zephyr/soc/litex/litex_vexriscv/Kconfig"
osource "/home/flo/projects/stm32mp257f-dk/zephyr/zephyr/soc/ite/ec/Kconfig"
osource "/home/flo/projects/stm32mp257f-dk/zephyr/zephyr/soc/intel/wildcat_lake/Kconfig"
osource "/home/flo/projects/stm32mp257f-dk/zephyr/zephyr/soc/intel/raptor_lake/Kconfig"
osource "/home/flo/projects/stm32mp257f-dk/zephyr/zephyr/soc/intel/panther_lake/Kconfig"
osource "/home/flo/projects/stm32mp257f-dk/zephyr/zephyr/soc/intel/lakemont/Kconfig"
osource "/home/flo/projects/stm32mp257f-dk/zephyr/zephyr/soc/intel/intel_socfpga_std/Kconfig"
osource "/home/flo/projects/stm32mp257f-dk/zephyr/zephyr/soc/intel/intel_socfpga/Kconfig"
osource "/home/flo/projects/stm32mp257f-dk/zephyr/zephyr/soc/intel/intel_niosv/Kconfig"
osource "/home/flo/projects/stm32mp257f-dk/zephyr/zephyr/soc/intel/intel_ish/Kconfig"
osource "/home/flo/projects/stm32mp257f-dk/zephyr/zephyr/soc/intel/intel_adsp/Kconfig"
osource "/home/flo/projects/stm32mp257f-dk/zephyr/zephyr/soc/intel/elkhart_lake/Kconfig"
osource "/home/flo/projects/stm32mp257f-dk/zephyr/zephyr/soc/intel/atom/Kconfig"
osource "/home/flo/projects/stm32mp257f-dk/zephyr/zephyr/soc/intel/apollo_lake/Kconfig"
osource "/home/flo/projects/stm32mp257f-dk/zephyr/zephyr/soc/intel/alder_lake/Kconfig"
osource "/home/flo/projects/stm32mp257f-dk/zephyr/zephyr/soc/infineon/psoc4/Kconfig"
osource "/home/flo/projects/stm32mp257f-dk/zephyr/zephyr/soc/infineon/edge/Kconfig"
osource "/home/flo/projects/stm32mp257f-dk/zephyr/zephyr/soc/infineon/cat3/Kconfig"
osource "/home/flo/projects/stm32mp257f-dk/zephyr/zephyr/soc/infineon/cat1c/Kconfig"
osource "/home/flo/projects/stm32mp257f-dk/zephyr/zephyr/soc/infineon/cat1b/Kconfig"
osource "/home/flo/projects/stm32mp257f-dk/zephyr/zephyr/soc/infineon/cat1a/Kconfig"
osource "/home/flo/projects/stm32mp257f-dk/zephyr/zephyr/soc/gd/gd32/Kconfig"
osource "/home/flo/projects/stm32mp257f-dk/zephyr/zephyr/soc/gaisler/leon3/Kconfig"
osource "/home/flo/projects/stm32mp257f-dk/zephyr/zephyr/soc/gaisler/gr716a/Kconfig"
osource "/home/flo/projects/stm32mp257f-dk/zephyr/zephyr/soc/focaltech/Kconfig"
osource "/home/flo/projects/stm32mp257f-dk/zephyr/zephyr/soc/espressif/Kconfig"
osource "/home/flo/projects/stm32mp257f-dk/zephyr/zephyr/soc/ene/kb1200/Kconfig"
osource "/home/flo/projects/stm32mp257f-dk/zephyr/zephyr/soc/ene/kb106x/Kconfig"
osource "/home/flo/projects/stm32mp257f-dk/zephyr/zephyr/soc/elan/em32f967/Kconfig"
osource "/home/flo/projects/stm32mp257f-dk/zephyr/zephyr/soc/egis/Kconfig"
osource "/home/flo/projects/stm32mp257f-dk/zephyr/zephyr/soc/efinix/sapphire/Kconfig"
osource "/home/flo/projects/stm32mp257f-dk/zephyr/zephyr/soc/cdns/xtensa_sample_controller/Kconfig"
osource "/home/flo/projects/stm32mp257f-dk/zephyr/zephyr/soc/cdns/swerv/Kconfig"
osource "/home/flo/projects/stm32mp257f-dk/zephyr/zephyr/soc/cdns/sample_controller32/Kconfig"
osource "/home/flo/projects/stm32mp257f-dk/zephyr/zephyr/soc/cdns/dc233c/Kconfig"
osource "/home/flo/projects/stm32mp257f-dk/zephyr/zephyr/soc/brcm/bcmvk/Kconfig"
osource "/home/flo/projects/stm32mp257f-dk/zephyr/zephyr/soc/brcm/bcm2712/Kconfig"
osource "/home/flo/projects/stm32mp257f-dk/zephyr/zephyr/soc/brcm/bcm2711/Kconfig"
osource "/home/flo/projects/stm32mp257f-dk/zephyr/zephyr/soc/blackberry/qnxhv_vm/Kconfig"
osource "/home/flo/projects/stm32mp257f-dk/zephyr/zephyr/soc/bflb/Kconfig"
osource "/home/flo/projects/stm32mp257f-dk/zephyr/zephyr/soc/atmel/sam0/Kconfig"
osource "/home/flo/projects/stm32mp257f-dk/zephyr/zephyr/soc/atmel/sam/Kconfig"
osource "/home/flo/projects/stm32mp257f-dk/zephyr/zephyr/soc/aspeed/Kconfig"
osource "/home/flo/projects/stm32mp257f-dk/zephyr/zephyr/soc/arm/Kconfig"
osource "/home/flo/projects/stm32mp257f-dk/zephyr/zephyr/soc/arm/beetle/Kconfig"
osource "/home/flo/projects/stm32mp257f-dk/zephyr/zephyr/soc/antmicro/myra/Kconfig"
osource "/home/flo/projects/stm32mp257f-dk/zephyr/zephyr/soc/andestech/Kconfig"
osource "/home/flo/projects/stm32mp257f-dk/zephyr/zephyr/soc/amd/acp_6_0/Kconfig"
osource "/home/flo/projects/stm32mp257f-dk/zephyr/zephyr/soc/ambiq/Kconfig"
osource "/home/flo/projects/stm32mp257f-dk/zephyr/zephyr/soc/allwinner/sun8i_h3/Kconfig"
osource "/home/flo/projects/stm32mp257f-dk/zephyr/zephyr/soc/alif/ensemble/Kconfig"
osource "/home/flo/projects/stm32mp257f-dk/zephyr/zephyr/soc/aesc/Kconfig"
osource "/home/flo/projects/stm32mp257f-dk/zephyr/zephyr/soc/adi/max32/Kconfig"
```
